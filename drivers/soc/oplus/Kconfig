## drivers/soc/oplus/Kconfig
```kconfig
source "drivers/soc/oplus/device_info/Kconfig"
source "drivers/soc/oplus/oplus_custom/Kconfig"
source "drivers/soc/oplus/oplus_als_cali_value/Kconfig"
source "drivers/soc/oplus/system/Kconfig"
```
